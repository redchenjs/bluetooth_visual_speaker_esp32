## main/Kconfig.projbuild
```kconfig
menu "Bluetooth Visual Speaker"

menu "Bluetooth Configuration"
config BT_NAME
    string "Bluetooth Name"
    default "Bluetooth Speaker"

config ENABLE_BLE_CONTROL_IF
    bool "Enable BLE Control Interface"
    default n

config BLE_NAME
    string "BLE Control Interface Name"
    default "Bluetooth Speaker BLE"
    depends on ENABLE_BLE_CONTROL_IF
endmenu

menu "Audio Configuration"
menuconfig ENABLE_AUDIO_PROMPT
    bool "Enable Audio Prompt"
    default y

config AUDIO_PROMPT_CONNECTED
    bool "Connected"
    default y
    depends on ENABLE_AUDIO_PROMPT

config AUDIO_PROMPT_DISCONNECTED
    bool "Disconnected"
    default y
    depends on ENABLE_AUDIO_PROMPT

config AUDIO_PROMPT_SLEEP
    bool "Sleep"
    default y
    depends on ENABLE_AUDIO_PROMPT && ENABLE_SLEEP_KEY

config AUDIO_PROMPT_WAKEUP
    bool "Wake-Up"
    default y
    depends on ENABLE_AUDIO_PROMPT && ENABLE_SLEEP_KEY

choice AUDIO_OUTPUT
    prompt "Audio Output"
    default AUDIO_OUTPUT_I2S1

    config AUDIO_OUTPUT_I2S0
        bool "I2S-0"
        depends on !AUDIO_INPUT_PDM
    config AUDIO_OUTPUT_I2S1
        bool "I2S-1"
endchoice

config AUDIO_OUTPUT_I2S_NUM
    int
    default 0 if AUDIO_OUTPUT_I2S0
    default 1 if AUDIO_OUTPUT_I2S1

choice AUDIO_INPUT
    prompt "Audio Input"
    default AUDIO_INPUT_NONE

    config AUDIO_INPUT_NONE
        bool "None"
    config AUDIO_INPUT_PDM
        bool "PDM"
    config AUDIO_INPUT_I2S0
        bool "I2S-0"
    config AUDIO_INPUT_I2S1
        bool "I2S-1"
endchoice

config AUDIO_INPUT_I2S_NUM
    int
    default 0 if AUDIO_INPUT_I2S0 || AUDIO_INPUT_PDM
    default 1 if AUDIO_INPUT_I2S1
    default 2 if AUDIO_INPUT_NONE

config I2S0_BCLK_PIN
    int "I2S-0 BCLK Pin"
    default 12
    depends on AUDIO_OUTPUT_I2S0 || AUDIO_INPUT_I2S0

config I2S0_LRCK_PIN
    int "I2S-0 LRCK Pin"
    default 15
    depends on AUDIO_OUTPUT_I2S0 || AUDIO_INPUT_I2S0

config I2S0_DOUT_PIN
    int "I2S-0 DOUT Pin"
    default 19
    depends on AUDIO_OUTPUT_I2S0

config I2S0_DIN_PIN
    int "I2S-0 DIN Pin"
    default 13
    depends on AUDIO_INPUT_I2S0

config I2S1_BCLK_PIN
    int "I2S-1 BCLK Pin"
    default 22
    depends on AUDIO_OUTPUT_I2S1 || AUDIO_INPUT_I2S1

config I2S1_LRCK_PIN
    int "I2S-1 LRCK Pin"
    default 21
    depends on AUDIO_OUTPUT_I2S1 || AUDIO_INPUT_I2S1

config I2S1_DOUT_PIN
    int "I2S-1 DOUT Pin"
    default 19
    depends on AUDIO_OUTPUT_I2S1

config I2S1_DIN_PIN
    int "I2S-1 DIN Pin"
    default 13
    depends on AUDIO_INPUT_I2S1

config PDM_CLK_PIN
    int "PDM CLK Pin"
    default 13
    depends on AUDIO_INPUT_PDM

config PDM_DIN_PIN
    int "PDM DIN Pin"
    default 15
    depends on AUDIO_INPUT_PDM
endmenu

menu "VFX Configuration"
config ENABLE_VFX
    bool "Enable Visual Effects Output"
    default n

choice AUDIO_INPUT_FFT_CHANNEL
    prompt "Audio FFT Channel - Input"
    default AUDIO_INPUT_FFT_ONLY_LEFT
    depends on ENABLE_VFX && !AUDIO_INPUT_NONE

config AUDIO_INPUT_FFT_ONLY_LEFT
    bool "Left"
config AUDIO_INPUT_FFT_ONLY_RIGHT
    bool "Right"
config AUDIO_INPUT_FFT_BOTH
    bool "Both"
endchoice

choice BT_AUDIO_FFT_CHANNEL
    prompt "Audio FFT Channel - Bluetooth"
    default BT_AUDIO_FFT_BOTH
    depends on ENABLE_VFX

config BT_AUDIO_FFT_ONLY_LEFT
    bool "Left"
config BT_AUDIO_FFT_ONLY_RIGHT
    bool "Right"
config BT_AUDIO_FFT_BOTH
    bool "Both"
endchoice

choice VFX_OUTPUT
    prompt "VFX Output Device"
    default VFX_OUTPUT_CUBE0414
    depends on ENABLE_VFX

config VFX_OUTPUT_WS2812
    bool "WS2812 8x8 LED Panel"
config VFX_OUTPUT_ST7735
    bool "ST7735 80x160 LCD Panel"
config VFX_OUTPUT_ST7789
    bool "ST7789 135x240 LCD Panel"
config VFX_OUTPUT_CUBE0414
    bool "CUBE0414 8x8x8 LED Light Cube"
endchoice

choice CUBE0414_RTL_REVISION
    prompt "CUBE0414 RTL Revision"
    default CUBE0414_RTL_REV_4
    depends on ENABLE_VFX && VFX_OUTPUT_CUBE0414

config CUBE0414_RTL_REV_2
    bool "Rev 2"
config CUBE0414_RTL_REV_3
    bool "Rev 3"
config CUBE0414_RTL_REV_4
    bool "Rev 4"
endchoice

choice LCD_ORIENTATION
    prompt "LCD Orientation"
    default LCD_ORIENTATION_NORMAL
    depends on ENABLE_VFX && !VFX_OUTPUT_WS2812 && !VFX_OUTPUT_CUBE0414

config LCD_ORIENTATION_NORMAL
    bool "Normal"
config LCD_ORIENTATION_UPSIDE_DOWN
    bool "Upside Down"
endchoice

config LCD_ROTATION_DEGREE
    int
    default  90 if LCD_ORIENTATION_NORMAL
    default 270 if LCD_ORIENTATION_UPSIDE_DOWN

choice LED_SCAN_TYPE
    prompt "LED Scan Type"
    default LED_SCAN_S_CURVE
    depends on ENABLE_VFX && (VFX_OUTPUT_WS2812 || VFX_OUTPUT_CUBE0414)

config LED_SCAN_S_CURVE
    bool "S Curve"
config LED_SCAN_LINE_BY_LINE
    bool "Line by line"
endchoice

choice LED_COLOR_ORDER
    prompt "LED Color Order"
    default LED_COLOR_ODR_RGB
    depends on ENABLE_VFX && (VFX_OUTPUT_WS2812 || VFX_OUTPUT_CUBE0414)

config LED_COLOR_ODR_RGB
    bool "R-G-B"
config LED_COLOR_ODR_GRB
    bool "G-R-B"
endchoice

choice LED_LAYER_DIRECTION
    prompt "LED Layer Direction"
    default LED_LAYER_DIR_XYZ
    depends on ENABLE_VFX && (VFX_OUTPUT_WS2812 || VFX_OUTPUT_CUBE0414)

config LED_LAYER_DIR_XYZ
    bool "X-Y-Z"
config LED_LAYER_DIR_XZY
    bool "X-Z-Y"
config LED_LAYER_DIR_YXZ
    bool "Y-X-Z"
config LED_LAYER_DIR_YZX
    bool "Y-Z-X"
config LED_LAYER_DIR_ZXY
    bool "Z-X-Y"
config LED_LAYER_DIR_ZYX
    bool "Z-Y-X"
endchoice

config LED_LAYER_INV_X
    bool "LED Layer X-Inverted"
    default n
    depends on ENABLE_VFX && (VFX_OUTPUT_WS2812 || VFX_OUTPUT_CUBE0414)

config LED_LAYER_INV_Y
    bool "LED Layer Y-Inverted"
    default n
    depends on ENABLE_VFX && (VFX_OUTPUT_WS2812 || VFX_OUTPUT_CUBE0414)

config LED_LAYER_INV_Z
    bool "LED Layer Z-Inverted"
    default n
    depends on ENABLE_VFX && (VFX_OUTPUT_WS2812 || VFX_OUTPUT_CUBE0414)

config LED_PANEL_CASCADE
    int "LED Panel Cascade"
    default 1
    range 1 8
    depends on ENABLE_VFX && VFX_OUTPUT_WS2812

config LED_T0H_TIME
    int "LED T0H Time (10 ns)"
    default 40
    range 1 256
    depends on ENABLE_VFX && (VFX_OUTPUT_WS2812 || (VFX_OUTPUT_CUBE0414 && !CUBE0414_RTL_REV_2))

config LED_T0L_TIME
    int "LED T0L Time (10 ns)"
    default 85
    range 1 256
    depends on ENABLE_VFX && (VFX_OUTPUT_WS2812 || (VFX_OUTPUT_CUBE0414 && !CUBE0414_RTL_REV_2))

config LED_T1H_TIME
    int "LED T1H Time (10 ns)"
    default 85
    range 1 256
    depends on ENABLE_VFX && (VFX_OUTPUT_WS2812 || (VFX_OUTPUT_CUBE0414 && !CUBE0414_RTL_REV_2))

config LED_T1L_TIME
    int "LED T1L Time (10 ns)"
    default 40
    range 1 256
    depends on ENABLE_VFX && (VFX_OUTPUT_WS2812 || (VFX_OUTPUT_CUBE0414 && !CUBE0414_RTL_REV_2))

config LED_CHAN_LEN
    int "LED Channel Length"
    default 64
    range 1 256
    depends on ENABLE_VFX && VFX_OUTPUT_CUBE0414 && !CUBE0414_RTL_REV_2

config LED_CHAN_CNT
    int "LED Channel Count"
    default 8
    range 1 16
    depends on ENABLE_VFX && VFX_OUTPUT_CUBE0414 && !CUBE0414_RTL_REV_2

config WS2812_DIN0_PIN
    int "WS2812 DIN0 Pin"
    default 18
    depends on ENABLE_VFX && VFX_OUTPUT_WS2812

config WS2812_DIN1_PIN
    int "WS2812 DIN1 Pin"
    default 19
    depends on ENABLE_VFX && VFX_OUTPUT_WS2812 && LED_PANEL_CASCADE > 4

config CUBE0414_RST_PIN
    int "CUBE0414 RST Pin"
    default 14
    depends on ENABLE_VFX && VFX_OUTPUT_CUBE0414 && !CUBE0414_RTL_REV_2

config CUBE0414_DC_PIN
    int "CUBE0414 DC Pin"
    default 23
    depends on ENABLE_VFX && VFX_OUTPUT_CUBE0414

config LCD_RST_PIN
    int "LCD RST Pin"
    default 14
    depends on ENABLE_VFX && !VFX_OUTPUT_WS2812 && !VFX_OUTPUT_CUBE0414

config LCD_DC_PIN
    int "LCD DC Pin"
    default 23
    depends on ENABLE_VFX && !VFX_OUTPUT_WS2812 && !VFX_OUTPUT_CUBE0414

config LCD_BL_PIN
    int "LCD BL Pin"
    default 4
    depends on ENABLE_VFX && !VFX_OUTPUT_WS2812 && !VFX_OUTPUT_CUBE0414

config SPI_SCLK_PIN
    int "SPI SCLK Pin"
    default 5
    depends on ENABLE_VFX && !VFX_OUTPUT_WS2812

config SPI_MOSI_PIN
    int "SPI MOSI Pin"
    default 18
    depends on ENABLE_VFX && !VFX_OUTPUT_WS2812

config SPI_MISO_PIN
    int "SPI MISO Pin"
    default 19
    depends on ENABLE_VFX && VFX_OUTPUT_CUBE0414 && CUBE0414_RTL_REV_4

config SPI_CS_PIN
    int "SPI CS Pin"
    default 27
    depends on ENABLE_VFX && !VFX_OUTPUT_WS2812
endmenu

menu "LED Configuration"
config ENABLE_LED
    bool "Enable LED"
    default n

choice LED_ACTIVE_LEVEL
    prompt "LED Active Level"
    default LED_ACTIVE_HIGH
    depends on ENABLE_LED

config LED_ACTIVE_HIGH
    bool "Active High"
config LED_ACTIVE_LOW
    bool "Active Low"
endchoice

config LED_PIN
    int "LED Pin"
    default 25
    depends on ENABLE_LED
endmenu

menu "Key Configuration"
config ENABLE_SLEEP_KEY
    bool "Enable Sleep Key"
    default n

config SLEEP_KEY_HOLD_TIME
    int "Sleep Key Hold Time (ms)"
    default 50
    depends on ENABLE_SLEEP_KEY

choice SLEEP_KEY_ACTIVE_LEVEL
    prompt "Sleep Key Active Level"
    default SLEEP_KEY_ACTIVE_LOW
    depends on ENABLE_SLEEP_KEY

config SLEEP_KEY_ACTIVE_HIGH
    bool "Active High"
config SLEEP_KEY_ACTIVE_LOW
    bool "Active Low"
endchoice

config SLEEP_KEY_PIN
    int "Sleep Key Pin"
    default 0
    depends on ENABLE_SLEEP_KEY
endmenu

endmenu
```

## sdkconfig.defaults
```kconfig
#
# Bootloader config
#
CONFIG_BOOTLOADER_SKIP_VALIDATE_IN_DEEP_SLEEP=y

#
# Serial flasher config
#
CONFIG_ESPTOOLPY_FLASHMODE_QIO=y
CONFIG_ESPTOOLPY_FLASHFREQ_80M=y
CONFIG_ESPTOOLPY_FLASHSIZE_4MB=y

#
# Partition Table
#
CONFIG_PARTITION_TABLE_CUSTOM=y
CONFIG_PARTITION_TABLE_CUSTOM_FILENAME="partitions.csv"

#
# Bluetooth
#
CONFIG_BT_ENABLED=y
CONFIG_BTDM_CTRL_MODE_BTDM=y
CONFIG_BTDM_CTRL_BLE_MAX_CONN=1
CONFIG_BTDM_CTRL_BR_EDR_MAX_ACL_CONN=1
CONFIG_BTDM_CTRL_AUTO_LATENCY=y
CONFIG_BT_BLUEDROID_ENABLED=y
CONFIG_BT_CLASSIC_ENABLED=y
CONFIG_BT_A2DP_ENABLE=y
CONFIG_BT_SSP_ENABLED=y
CONFIG_BT_BLE_ENABLED=y
CONFIG_BT_GATTS_ENABLE=y
CONFIG_BT_GATTC_ENABLE=n
CONFIG_BT_BLE_SMP_ENABLE=n
CONFIG_BT_STACK_NO_LOG=y
CONFIG_BT_ACL_CONNECTIONS=2

#
# Compiler options
#
CONFIG_COMPILER_OPTIMIZATION_PERF=y

#
# ESP32-specific
#
CONFIG_ESP32_REV_MIN_1=y
CONFIG_ESP32_DEFAULT_CPU_FREQ_240=y

#
# Common ESP-related
#
CONFIG_ESP_TASK_WDT=n

#
# Newlib
#
CONFIG_NEWLIB_NANO_FORMAT=y

#
# FreeRTOS
#
CONFIG_FREERTOS_HZ=1000
CONFIG_FREERTOS_SUPPORT_STATIC_ALLOCATION=y
```
